## Documentation/devicetree/bindings/misc/ashen,hbv1.yaml
```yaml
# SPDX-License-Identifier: (GPL-2.0-only OR BSD-2-Clause)
%YAML 1.2
---
$id: http://devicetree.org/schemas/misc/ashen,hbv1.yaml#
$schema: http://devicetree.org/meta-schemas/core.yaml#

title: Ashen tamper monitor

maintainers:
  - Jan Sebastian Götte <kernel@yasec.de>

description:
  A microcontroller attached over a UART that watches tamper sensors. The
  host keeps an encrypted heartbeat link to it and panics when the monitor
  reports tamper or stops answering.

allOf:
  - $ref: /schemas/serial/serial-peripheral-props.yaml#

properties:
  compatible:
    const: ashen,hbv1

  timeout-us:
    description:
      Time after the last heartbeat reply at which the host gives up on the
      monitor and panics, while the heartbeat is armed.
    default: 10000

  refresh-ivl-us:
    description: Interval between heartbeat requests.
    default: 5000

  no-autostart:
    type: boolean
    description:
      Do not arm the heartbeat once the link is up; leave arming to
      userspace.

required:
  - compatible

unevaluatedProperties: false

examples:
  - |
    serial {
        tamper {
            compatible = "ashen,hbv1";
            current-speed = <4000000>;
            timeout-us = <100000>;
            refresh-ivl-us = <50000>;
            no-autostart;
        };
    };
```

## drivers/misc/ashen-tamper/Kconfig
```kconfig
# SPDX-License-Identifier: GPL-2.0-only
#
# Ashen Tamper Alarm Driver
#

config ASHEN_TAMPER
	tristate "Ashen Sensor Heartbeat Protocol Support"
	select AUXILIARY_BUS
	select CRYPTO_LIB_CURVE25519
	select CRYPTO_LIB_CHACHA20POLY1305
	select CRYPTO_LIB_SHA256
	help
	  Driver for the Ashen tamper monitor, a microcontroller attached over
	  a UART that watches tamper sensors. The driver keeps an encrypted
	  Noise_XX link to the monitor and exchanges heartbeats with it. When
	  the monitor reports tamper or stops answering while the heartbeat is
	  armed, the driver panics the kernel so that a crash kernel can wipe
	  memory.

	  To compile this driver as a module, choose M here: the module will
	  be called ashen-tamper.

config ASHEN_TAMPER_KUNIT_TEST
	tristate "KUnit tests for Ashen tamper protocol" if !KUNIT_ALL_TESTS
	depends on KUNIT
	select CRYPTO_LIB_CURVE25519
	select CRYPTO_LIB_CHACHA20POLY1305
	select CRYPTO_LIB_SHA256
	default KUNIT_ALL_TESTS
	help
	  Protocol-level tests (COBS framing + Noise handshake/transport)
	  for the ashen-tamper driver. The test compiles the protocol sources
	  directly, so it does not need the serdev-based driver and builds under
	  the UML KUnit target. Say N unless you are testing.
```
